/*
 * Copyright (c) 2022 The ZMK Contributors
 *
 * SPDX-License-Identifier: MIT
 */

#include "sofle_rgb_keyhive.dtsi"

&default_transform {
    col-offset = <2>;
};

&kscan0 {
    col-gpios = <&pro_micro 10 GPIO_ACTIVE_HIGH>,
                <&pro_micro 16 GPIO_ACTIVE_HIGH>;
};

&right_encoder {
    status = "okay";
};
